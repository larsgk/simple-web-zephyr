## west.yml
```yaml
manifest:
  remotes:
    - name: zephyrproject-rtos
      url-base: https://github.com/zephyrproject-rtos

  projects:
    - name: zephyr
      remote: zephyrproject-rtos
      revision: v3.4.0
      import:
        name-allowlist:
          - cmsis
          - hal_nordic
          - tinycrypt
          - libmetal
          - open-amp
          
```
