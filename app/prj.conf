## prj.conf
```kconfig
# Bluetooth & Settings
CONFIG_BT=y
CONFIG_BT_DEBUG_LOG=y
CONFIG_BT_SMP=y
CONFIG_BT_PERIPHERAL=y
CONFIG_BT_DEVICE_NAME="Simple Web Zephyr"
CONFIG_BT_DEVICE_NAME_DYNAMIC=y
#CONFIG_BT_DEVICE_NAME_GATT_WRITABLE=y
CONFIG_BT_SETTINGS=y
CONFIG_FLASH=y
CONFIG_FLASH_PAGE_LAYOUT=y
CONFIG_FLASH_MAP=y
CONFIG_NVS=y
CONFIG_SETTINGS=y

# Shell & Logging
CONFIG_PRINTK=y
```

## boards/nrf52840dongle_nrf52840.conf
```kconfig
CONFIG_GPIO=y
CONFIG_PWM=y

# USB
CONFIG_USB_DEVICE_STACK=y
CONFIG_USB_DEVICE_PRODUCT="Simple Web Dongle USB console"
CONFIG_USB_DEVICE_PID=0x0004
CONFIG_USB_DEVICE_INITIALIZE_AT_BOOT=n

CONFIG_SERIAL=y
CONFIG_CONSOLE=y
CONFIG_UART_CONSOLE=y
CONFIG_UART_LINE_CTRL=y
```

## boards/nrf5340_audio_dk_nrf5340_cpuapp.conf
```kconfig
CONFIG_GPIO=y
CONFIG_PWM=y

CONFIG_BT_HCI_ACL_FLOW_CONTROL=n
CONFIG_BT_HCI_VS_EXT=n
CONFIG_BT_TINYCRYPT_ECC=y

CONFIG_SHELL_STACK_SIZE=4096

CONFIG_LOG=y
CONFIG_BT_DEBUG_LOG=y
CONFIG_BT_GATT_LOG_LEVEL_DBG=y
```

## src/main.c
```c
#include <zephyr/kernel.h>

#include <zephyr/settings/settings.h>

#include <zephyr/bluetooth/bluetooth.h>
#include <zephyr/bluetooth/conn.h>
#include <zephyr/bluetooth/gatt.h>
#include <zephyr/bluetooth/hci.h>
#include <zephyr/bluetooth/uuid.h>

#if defined(CONFIG_GPIO)
#include <zephyr/drivers/gpio.h>
#endif

/* Enable USB for the nRF52840 Dongle */
#if defined(CONFIG_BOARD_NRF52840DONGLE_NRF52840)
#include <zephyr/usb/usb_device.h>
#include <zephyr/drivers/uart.h>
#endif

#include "rgb_led.h"
#include "simple_io_service.h"

static const struct bt_data ad[] = {
	BT_DATA_BYTES(BT_DATA_FLAGS, (BT_LE_AD_GENERAL | BT_LE_AD_NO_BREDR)),
	BT_DATA_BYTES(BT_DATA_UUID128_ALL, BT_UUID_SIMPLE_IO_SERVICE),
};

enum breathing_light_mask_values {
	BREATHING_LIGHT_OFF = 0,
	BREATHING_LIGHT_RED = 0x1,
	BREATHING_LIGHT_GREEN = 0x2,
    BREATHING_LIGHT_YELLOW = 0x3,
	BREATHING_LIGHT_BLUE = 0x4,
	BREATHING_LIGHT_MAGENTA = 0x5,
    BREATHING_LIGHT_CYAN = 0x6,
    BREATHING_LIGHT_WHITE = 0x7,
};

int8_t breathing_light = BREATHING_LIGHT_BLUE; // blue

static void set_rgb_cb(uint8_t r, uint8_t g, uint8_t b) {
	breathing_light = BREATHING_LIGHT_OFF; // Disable breathing light when setting RGB color

	printk("%s: Set RGB (r, g, b) = (%u, %u, %u)\n", __func__, r, g, b);

	rgb_led_set(r, g, b);
}

struct bt_simple_io_cb io_cbs = {
	.set_rgb = set_rgb_cb,
};

static void bt_ready(void)
{
	int err;

	printk("%s: Bluetooth initialized\n", __func__);

    if (IS_ENABLED(CONFIG_SETTINGS)) {
		settings_load();
	}

	bt_simple_io_register_cb(&io_cbs);

	err = bt_le_adv_start(BT_LE_ADV_CONN_NAME, ad, ARRAY_SIZE(ad), NULL, 0);
	if (err) {
		printk("%s: Advertising failed to start (err %d)\n", __func__, err);
		return;
	}

	printk("%s: Advertising successfully started\n", __func__);
}

static void connected(struct bt_conn *conn, uint8_t err)
{
	if (err) {
		printk("%s: Connection failed (err 0x%02x)\n", __func__, err);
		breathing_light = BREATHING_LIGHT_RED;
	} else {
		printk("%s: Connected\n", __func__);
		breathing_light = BREATHING_LIGHT_GREEN;
	}
}

static void disconnected(struct bt_conn *conn, uint8_t reason)
{
	printk("%s: Disconnected (reason 0x%02x)\n", __func__, reason);
	breathing_light = BREATHING_LIGHT_BLUE;
}

BT_CONN_CB_DEFINE(conn_callbacks) = {
	.connected = connected,
	.disconnected = disconnected,
};

#if defined(CONFIG_GPIO)
static const struct gpio_dt_spec button = GPIO_DT_SPEC_GET_OR(DT_ALIAS(sw0), gpios,
							      {0});
static struct gpio_callback button_cb_data;

static struct k_work button_work;

void button_pressed(const struct device *dev, struct gpio_callback *cb,
		    uint32_t pins)
{
	k_work_submit(&button_work);
}

void handle_button_event(struct k_work *work)
{
    int val = gpio_pin_get_dt(&button);

	printk("%s: Button = %d\n", __func__, val);

/* Enable the following line to change RGB color on button press/release */
#if 0
	breathing_light = BREATHING_LIGHT_OFF; // Disable breathing light when setting RGB color
    if (val) {
        rgb_led_set(255,0,0);
    } else {
        rgb_led_set(0,255,0);
    }
#endif
    simple_io_button_notify(val);
}
#endif

/* Breathing light step duration*/
#define SLEEP_MS 10

int main(void)
{
	int err;
	int8_t state = 0;
	int32_t val = 0;

	/* Enable USB for the nRF52840 Dongle */
#if defined(CONFIG_BOARD_NRF52840DONGLE_NRF52840)
	const struct device *const dev = DEVICE_DT_GET(DT_CHOSEN(zephyr_console));
	uint32_t dtr = 0;

	if (usb_enable(NULL)) {
		return 0;
	}

	// Uncomment the following to wait until connected
	// while (!dtr) {
	// 	uart_line_ctrl_get(dev, UART_LINE_CTRL_DTR, &dtr);
	// 	k_sleep(K_MSEC(100));
	// }
#endif

    /* Check that the RGB PWM devices are present*/
    printk("Initialize RGB LED...\n");
    err = rgb_led_init();
    if (err) {
        printk("Error setting up RGB light!\n");
        return 0;
    }

#if defined(CONFIG_GPIO)
    printk("Initialize Button...\n");
	if (!gpio_is_ready_dt(&button)) {
		printk("Error: button device %s is not ready\n",
		       button.port->name);
		return 0;
	}

	err = gpio_pin_configure_dt(&button, GPIO_INPUT);
	if (err != 0) {
		printk("Error %d: failed to configure %s pin %d\n",
		       err, button.port->name, button.pin);
		return 0;
	}

	err = gpio_pin_interrupt_configure_dt(&button, GPIO_INT_EDGE_BOTH);
	if (err != 0) {
		printk("Error %d: failed to configure interrupt on %s pin %d\n",
			err, button.port->name, button.pin);
		return 0;
	}

	k_work_init(&button_work, handle_button_event);

	gpio_init_callback(&button_cb_data, button_pressed, BIT(button.pin));
	gpio_add_callback(button.port, &button_cb_data);
	printk("Set up button at %s pin %d\n", button.port->name, button.pin);
#endif

	// Enable BT
	err = bt_enable(NULL);
	if (err) {
		printk("Bluetooth init failed (err %d)\n", err);
		return 0;
	}

	bt_ready();

    /* Loop for the breathing/fading lights */
	while (1) {
		k_msleep(SLEEP_MS);
		if (breathing_light != BREATHING_LIGHT_OFF) {
			rgb_led_set(
				(breathing_light & 0x1) ? val : 0,
				(breathing_light & 0x2) ? val : 0,
				(breathing_light & 0x4) ? val : 0);

			val += (state & 0x10) == 0 ? 2 : -2;

			if (val >= 0xFE) {
				state ^= 0x10;
			} else if (val < 0x01) {
				state ^= 0x10;
			}
		} 
	}
}
```

## src/rgb_led.c
```c
#include <zephyr/kernel.h>
#include <zephyr/sys/printk.h>
#include <zephyr/device.h>
#include <zephyr/drivers/pwm.h>

#include "rgb_led.h"

#define PERIOD (USEC_PER_SEC / 100)

static const struct pwm_dt_spec red_pwm_led =
	PWM_DT_SPEC_GET(DT_ALIAS(red_pwm_led));
static const struct pwm_dt_spec green_pwm_led =
	PWM_DT_SPEC_GET(DT_ALIAS(green_pwm_led));
static const struct pwm_dt_spec blue_pwm_led =
	PWM_DT_SPEC_GET(DT_ALIAS(blue_pwm_led));

int rgb_led_init()
{
	if (!device_is_ready(red_pwm_led.dev) ||
	    !device_is_ready(green_pwm_led.dev) ||
	    !device_is_ready(blue_pwm_led.dev)) {
		return -ENODEV;
	}

    return 0;
}

void rgb_led_set(uint8_t r, uint8_t g, uint8_t b)
{
    uint32_t pulse_red, pulse_green, pulse_blue;

    pulse_red = (red_pwm_led.period >> 8) * r;
    pulse_green = (green_pwm_led.period >> 8) * g;
    pulse_blue = (blue_pwm_led.period >> 8) * b;

    if( pwm_set_pulse_dt(&red_pwm_led, pulse_red) != 0 ||
        pwm_set_pulse_dt(&green_pwm_led, pulse_green) != 0 ||
        pwm_set_pulse_dt(&blue_pwm_led, pulse_blue) != 0) {
        printk("Error setting RGB PWM\n");
    }
}
```

## src/simple_io_service.c
```c
#include <zephyr/types.h>
#include <stddef.h>
#include <string.h>
#include <errno.h>
#include <zephyr/sys/printk.h>
#include <zephyr/kernel.h>

#include <zephyr/bluetooth/bluetooth.h>
#include <zephyr/bluetooth/uuid.h>
#include <zephyr/bluetooth/gatt.h>

#include "simple_io_service.h"

static struct bt_uuid_128 simple_io_service_uuid = BT_UUID_INIT_128(
	BT_UUID_SIMPLE_IO_SERVICE);

// 0x13e779a0, 0xbb72, 0x43a4, 0xa748, 0x9781b918258c (service)
// 0x4332aca6, 0x6d71, 0x4173, 0x9945, 0x6653b6c684a0 (rgb [WRITE])
// 0xb749d964, 0x4efb, 0x408a, 0x82ad, 0x7495e8af8d6d (id [WRITE])
// 0x030de9cf, 0xce4b, 0x44d0, 0x8aa2, 0x1db9185dc069 (button [NOTIFY])

static const struct bt_uuid_128 simple_io_rgb_uuid = BT_UUID_INIT_128(
	BT_UUID_128_ENCODE(0x4332aca6, 0x6d71, 0x4173, 0x9945, 0x6653b6c684a0));

static const struct bt_uuid_128 simple_io_id_uuid = BT_UUID_INIT_128(
	BT_UUID_128_ENCODE(0xb749d964, 0x4efb, 0x408a, 0x82ad, 0x7495e8af8d6d));

static const struct bt_uuid_128 simple_io_button_uuid = BT_UUID_INIT_128(
	BT_UUID_128_ENCODE(0x030de9cf, 0xce4b, 0x44d0, 0x8aa2, 0x1db9185dc069));

static struct bt_simple_io_cb *simple_io_cbs;

void bt_simple_io_register_cb(struct bt_simple_io_cb *cb)
{
    simple_io_cbs = cb;
}

static ssize_t write_rgb(struct bt_conn *conn, const struct bt_gatt_attr *attr,
			const void *buf, uint16_t len, uint16_t offset,	uint8_t flags)
{
	uint8_t val[3];

	printk("%s: len=%zu, offset=%u\n", __func__, len, offset);

	if (offset != 0) {
		return BT_GATT_ERR(BT_ATT_ERR_INVALID_OFFSET);
	} else if (len != sizeof(val)) {
		return BT_GATT_ERR(BT_ATT_ERR_INVALID_ATTRIBUTE_LEN);
	}

	(void)memcpy(&val, buf, len);

    if (simple_io_cbs->set_rgb) {
        simple_io_cbs->set_rgb(val[0], val[1], val[2]);
    }

    return len;
}

static ssize_t write_id(struct bt_conn *conn, const struct bt_gatt_attr *attr,
			  const void *buf, uint16_t len, uint16_t offset,
			  uint8_t flags)
{
	char name[CONFIG_BT_DEVICE_NAME_MAX];
	int err;

	uint8_t val;

	printk("%s: len=%zu, offset=%u\n", __func__, len, offset);

	if (offset != 0) {
		return BT_GATT_ERR(BT_ATT_ERR_INVALID_OFFSET);
	} else if (len != sizeof(val)) {
		return BT_GATT_ERR(BT_ATT_ERR_INVALID_ATTRIBUTE_LEN);
	}

	(void)memcpy(&val, buf, len);

	/* Set the BT Name to "Simple Web Zephyr <ID>" (used for easier identification in workshops ;)) */
	snprintk(name, sizeof(name), "Simple Web Zephyr %u", val);

	err = bt_set_name(name);
	if (err) {
		return BT_GATT_ERR(BT_ATT_ERR_INSUFFICIENT_RESOURCES);
	}

	return len;
}

static void button_ccc_cfg_changed(const struct bt_gatt_attr *attr, uint16_t value)
{
	bool button_notif = (value == BT_GATT_CCC_NOTIFY);

	printk("Button notifications %s\n", button_notif ? "enabled" : "disabled");
}

/* Simple IO Service Declaration */
BT_GATT_SERVICE_DEFINE(simple_io_svc,
	BT_GATT_PRIMARY_SERVICE(&simple_io_service_uuid),
	BT_GATT_CHARACTERISTIC(&simple_io_button_uuid.uuid,
			       BT_GATT_CHRC_NOTIFY,
			       BT_GATT_PERM_NONE,
				   NULL, NULL, NULL),
	BT_GATT_CCC(button_ccc_cfg_changed,
			BT_GATT_PERM_READ | BT_GATT_PERM_WRITE),
    BT_GATT_CUD("Button(s)", BT_GATT_PERM_READ),
    BT_GATT_CHARACTERISTIC(&simple_io_rgb_uuid.uuid,
				BT_GATT_CHRC_WRITE,
                BT_GATT_PERM_WRITE,
                NULL, write_rgb, NULL),
    BT_GATT_CUD("RGB", BT_GATT_PERM_READ),
    BT_GATT_CHARACTERISTIC(&simple_io_id_uuid.uuid,
				BT_GATT_CHRC_WRITE,
                BT_GATT_PERM_WRITE,
                NULL, write_id, NULL),
    BT_GATT_CUD("Device ID", BT_GATT_PERM_READ),
);

int simple_io_button_notify(uint8_t pressed)
{
	int ret = bt_gatt_notify(NULL, &simple_io_svc.attrs[1], &pressed, sizeof(pressed));

	return ret == -ENOTCONN ? 0 : ret;
}
```

## src/simple_io_service.h
```c
#ifndef BT_SIMPLE_IO_SERVICE_H_
#define BT_SIMPLE_IO_SERVICE_H_

#include <zephyr/types.h>

#ifdef __cplusplus
extern "C" {
#endif

// Generated from https://www.uuidtools.com/

// 13e779a0-bb72-43a4-a748-9781b918258c (service)
// 4332aca6-6d71-4173-9945-6653b6c684a0 (rgb [WRITE])
// b749d964-4efb-408a-82ad-7495e8af8d6d (id [WRITE])
// 030de9cf-ce4b-44d0-8aa2-1db9185dc069 (button [NOTIFY])


#define BT_UUID_SIMPLE_IO_SERVICE \
	BT_UUID_128_ENCODE(0x13e779a0, 0xbb72, 0x43a4, 0xa748, 0x9781b918258c)

typedef void (*simple_io_set_rgb_cb)(uint8_t r, uint8_t g, uint8_t b);
// typedef void (*simple_io_name_cb)(int16_t vx, int16_t vy);

struct bt_simple_io_cb {
    simple_io_set_rgb_cb    set_rgb;
};

void bt_simple_io_register_cb(struct bt_simple_io_cb *cb);
int simple_io_button_notify(uint8_t pressed);

#ifdef __cplusplus
}
#endif

#endif /* BT_SIMPLE_IO_SERVICE_H_ */
```
